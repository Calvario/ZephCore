## zephcore/boards/esp32/lilygo_t3s3/Kconfig.lilygo_t3s3
```kconfig
# LilyGo T3S3 board configuration

# SPDX-License-Identifier: MIT

config BOARD_LILYGO_T3S3
	select SOC_ESP32S3_WROOM_N4R2
	select SOC_ESP32S3_PROCPU if BOARD_LILYGO_T3S3_ESP32S3_PROCPU
```

## zephcore/boards/esp32/meshnology_w12/Kconfig.meshnology_w12
```kconfig
config BOARD_MESHNOLOGY_W12
	select SOC_ESP32S3_WROOM_N16R8
	select SOC_ESP32S3_PROCPU if BOARD_MESHNOLOGY_W12_ESP32S3_PROCPU
```

## zephcore/boards/esp32/meshnology_w12/board.yml
```yaml
board:
  name: meshnology_w12
  full_name: Meshnology W12 LR2021
  vendor: meshnology
  socs:
    - name: esp32s3
```

## zephcore/boards/nrf52840/heltec_t1/Kconfig.heltec_t1
```kconfig
# Copyright (c) 2026 ZephCore
#
# SPDX-License-Identifier: MIT

config BOARD_HELTEC_T1
	select SOC_NRF52840_QIAA
```

## zephcore/boards/nrf52840/heltec_t1/board.yml
```yaml
# Copyright (c) 2026 ZephCore
#
# SPDX-License-Identifier: MIT

board:
  name: heltec_t1
  full_name: Heltec Mesh Node T1
  vendor: heltec
  socs:
  - name: nrf52840
```

## zephcore/boards/nrf52840/meshtracker_x1/Kconfig.meshtracker_x1
```kconfig
# Copyright (c) 2026 ZephCore
#
# SPDX-License-Identifier: MIT

config BOARD_MESHTRACKER_X1
	select SOC_NRF52840_QIAA
```

## zephcore/boards/nrf52840/meshtracker_x1/board.yml
```yaml
# Copyright (c) 2026 ZephCore
#
# SPDX-License-Identifier: MIT

board:
  name: meshtracker_x1
  full_name: Seeed SenseCAP MeshTracker X1
  vendor: seeed
  socs:
  - name: nrf52840
```

## zephcore/boards/nrf52840/wio_tracker_l1_1w/Kconfig.wio_tracker_l1_1w
```kconfig
# Copyright (c) 2025 MeshCore
#
# SPDX-License-Identifier: MIT

config BOARD_WIO_TRACKER_L1_1W
	select SOC_NRF52840_QIAA
	select ZEPHCORE_UI_JOYSTICK
```

## zephcore/boards/nrf52840/wio_tracker_l1_1w/board.yml
```yaml
# Copyright (c) 2025 MeshCore
#
# SPDX-License-Identifier: MIT

board:
  name: wio_tracker_l1_1w
  full_name: Seeed Wio Tracker L1 Pro 1W
  vendor: seeed
  socs:
  - name: nrf52840
```

## zephcore/boards/nrf54l/me25ls02/Kconfig.defconfig
```kconfig
# Copyright (c) 2026 ZephCore
# SPDX-License-Identifier: MIT

if BOARD_ME25LS02_NRF54L15_CPUAPP

config HAS_BT_CTLR
	default BT

endif # BOARD_ME25LS02_NRF54L15_CPUAPP
```

## zephcore/boards/nrf54l/me25ls02/Kconfig.me25ls02
```kconfig
# MinewSemi ME25LS02 board configuration
# Copyright (c) 2026 ZephCore
# SPDX-License-Identifier: MIT

config BOARD_ME25LS02
	select SOC_NRF54L15_CPUAPP if BOARD_ME25LS02_NRF54L15_CPUAPP
```

## zephcore/boards/nrf54l/me25ls02/board.yml
```yaml
# Copyright (c) 2026 ZephCore
# SPDX-License-Identifier: MIT

board:
  name: me25ls02
  full_name: MinewSemi ME25LS02 on MX25LE02 dev board (nRF54L15 + SX1262)
  vendor: minewsemi
  socs:
    - name: nrf54l15
```

## zephcore/boards/nrf54l/me25ls02/me25ls02_nrf54l15_cpuapp_defconfig
```kconfig
# MinewSemi ME25LS02 default configuration
# SPDX-License-Identifier: MIT

CONFIG_ARM_MPU=y
CONFIG_HW_STACK_PROTECTION=y
CONFIG_NULL_POINTER_EXCEPTION_DETECTION_NONE=y

CONFIG_CACHE_MANAGEMENT=y
CONFIG_EXTERNAL_CACHE=y

# Console on uart20 -> CH340x -> USB-C (no USB peripheral on this SoC)
CONFIG_SERIAL=y
CONFIG_CONSOLE=y
CONFIG_UART_CONSOLE=y

CONFIG_GPIO=y
CONFIG_PINCTRL=y
CONFIG_SPI=y

# RRAM + LittleFS
CONFIG_FLASH=y
CONFIG_FLASH_MAP=y

CONFIG_NRF_GRTC_START_SYSCOUNTER=y

CONFIG_REGULATOR=y
```

## zephcore/boards/nrf54l/seeed_lr2021_evk/Kconfig.defconfig
```kconfig
# Copyright (c) 2026 ZephCore
# SPDX-License-Identifier: MIT

if BOARD_SEEED_LR2021_EVK_NRF54L15_CPUAPP

config HAS_BT_CTLR
	default BT

endif # BOARD_SEEED_LR2021_EVK_NRF54L15_CPUAPP
```

## zephcore/boards/nrf54l/seeed_lr2021_evk/board.yml
```yaml
# Copyright (c) 2026 ZephCore
# SPDX-License-Identifier: MIT

board:
  name: seeed_lr2021_evk
  full_name: Semtech LR2021 LoRa Plus EVK (XIAO nRF54L15 + Wio-LR2021)
  vendor: seeed
  socs:
    - name: nrf54l15
```

## zephcore/dts/bindings/sensor/goertek,spa06.yaml
```yaml
# Copyright (c) 2026 ZephCore
# SPDX-License-Identifier: MIT

description: |
  Goertek SPA06-003 barometric pressure and temperature sensor.

  The driver runs the part in continuous background mode at 8x oversampling
  and 1 Hz for both channels, so sample_fetch never blocks. Channels are
  SENSOR_CHAN_PRESS (kPa) and SENSOR_CHAN_AMBIENT_TEMP (degrees C).

compatible: "goertek,spa06"

include: [sensor-device.yaml, i2c-device.yaml]
```

## zephcore/patches/zephyr-new/dts/bindings/lora/semtech,lr2021.yaml
```yaml
# Copyright (c) 2025 ZephCore
# SPDX-License-Identifier: MIT

description: |
  Semtech LR2021 LoRa Plus transceiver (4th-gen LoRa IP).
  Uses native Semtech lr20xx_driver SDK with Zephyr LoRa driver API.
  Supports sub-GHz + 2.4 GHz ISM + NTN/SATCOM.

compatible: "semtech,lr2021"

include: spi-device.yaml

properties:
  reset-gpios:
    type: phandle-array
    required: true
    description: GPIO connected to NRESET (active-low).

  busy-gpios:
    type: phandle-array
    required: true
    description: GPIO connected to BUSY (high = busy).

  dio1-gpios:
    type: phandle-array
    required: true
    description: GPIO connected to DIO5/IRQ line (active-high, pull-down).

  tcxo-voltage-mv:
    type: int
    default: 0
    description: |
      TCXO supply voltage in millivolts. On LR2021 the TCXO sits on XTA and is
      fed by the internal regulator via the VTCXO pin (datasheet S1.9.3) — not
      DIO3, despite what the SX126x-derived names elsewhere suggest.
      0 = no TCXO (use XTAL). Allowed: 1600, 1700, 1800, 2200, 2400, 2700,
      3000, 3300.

  tcxo-startup-delay-ms:
    type: int
    default: 10
    description: |
      Deadline for the 32 MHz TCXO to start and stabilise, in milliseconds.
      This is a timeout, not a fixed wait, so erring high only delays how
      quickly a dead oscillator is reported. Too low and the chip raises
      HF_XOSC_START_ERR and rejects every later command.

  rx-boosted:
    type: boolean
    description: Enable RX boosted mode for better sensitivity (+~3dB, +~2mA).

  irq-dio:
    type: int
    default: 9
    description: |
      Chip-side DIO wired to the MCU interrupt line, 5..11. This is the DIO
      number on the LR2021 itself, not the SoC pin — the SoC side is dio1-gpios.

  rfswitch-enable:
    type: int
    default: 0
    description: |
      RF switch DIO enable bitmask (bit 0 = DIO5, bit 1 = DIO6, ...).
      Set a bit to include that DIO in RF switch control.

  rfswitch-standby:
    type: int
    default: 0
    description: |
      Bitmask of RF switch DIOs that are HIGH in standby mode.
      Bit mapping matches rfswitch-enable.

  rfswitch-rx:
    type: int
    default: 0
    description: |
      Bitmask of RF switch DIOs that are HIGH in RX mode (both LF and HF).
      Bit mapping matches rfswitch-enable.

  rfswitch-tx:
    type: int
    default: 0
    description: |
      Bitmask of RF switch DIOs that are HIGH in sub-GHz TX mode (LF PA).
      Bit mapping matches rfswitch-enable.

  rfswitch-tx-hp:
    type: int
    default: 0
    description: |
      Bitmask of RF switch DIOs that are HIGH in 2.4 GHz / high-power TX mode (HF PA).
      Bit mapping matches rfswitch-enable.

  pa-hp-sel:
    type: int
    default: 7
    description: |
      LF PA number of slices (0-7). Maps to pa_lf_slices in the SDK.
      Higher = more PA output slices active = more power. Default 7 = maximum.

  pa-duty-cycle:
    type: int
    default: 4
    description: |
      LF PA duty cycle (0-7). Maps to pa_lf_duty_cycle in the SDK.
      Default 4 is suitable for most sub-GHz applications.
```

## zephcore/west.yml
```yaml
manifest:
  remotes:
    - name: zephyrproject-rtos
      url-base: https://github.com/zephyrproject-rtos

  projects:
    - name: zephyr
      remote: zephyrproject-rtos
      revision: 7d713288b4baab1cffecadf16f258d9a3885d713
      import: true

  self:
    path: zephcore
```
